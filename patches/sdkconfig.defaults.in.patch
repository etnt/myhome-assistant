## patches/sdkconfig.defaults.in.patch
```kconfig
--- a/src/platforms/esp32/sdkconfig.defaults.in
+++ b/src/platforms/esp32/sdkconfig.defaults.in
@@ -4,3 +4,12 @@
 CONFIG_LWIP_IPV6=n
 CONFIG_PARTITION_TABLE_CUSTOM_FILENAME="@AVM_PARTITION_TABLE_FILENAME@"
 CONFIG_APP_REPRODUCIBLE_BUILD=y
+
+# BLE disabled — offloaded to external XIAO nRF52840 via I2C
+CONFIG_BT_ENABLED=n
+
+# PSRAM (8 MB octal SPI on ESP32-S3-WROOM)
+CONFIG_SPIRAM=y
+CONFIG_SPIRAM_MODE_OCT=y
+CONFIG_SPIRAM_SPEED_80M=y
+CONFIG_SPIRAM_USE_MALLOC=y
```

## sdkconfig.defaults
```kconfig
# BLE (NimBLE) configuration for Hue light control
CONFIG_BT_ENABLED=y
CONFIG_BT_NIMBLE_ENABLED=y
CONFIG_BT_NIMBLE_ROLE_CENTRAL=y
CONFIG_BT_NIMBLE_ROLE_PERIPHERAL=n
CONFIG_BT_NIMBLE_ROLE_BROADCASTER=n
CONFIG_BT_NIMBLE_ROLE_OBSERVER=y

# Security / bonding
CONFIG_BT_NIMBLE_SM_LEGACY=y
CONFIG_BT_NIMBLE_SM_SC=y
CONFIG_BT_NIMBLE_NVS_PERSIST=y

# Connection parameters
CONFIG_BT_NIMBLE_MAX_CONNECTIONS=2
CONFIG_BT_NIMBLE_MAX_BONDS=3

# Increase stack for BLE host task
CONFIG_BT_NIMBLE_HOST_TASK_STACK_SIZE=4096

# Disable features we don't need
CONFIG_BT_NIMBLE_ROLE_PERIPHERAL=n
CONFIG_BT_NIMBLE_ROLE_BROADCASTER=n

# Console over USB Serial/JTAG (the /dev/cu.usbmodem* port on Mac)
CONFIG_ESP_CONSOLE_USB_SERIAL_JTAG=y
```
